## Documentation/devicetree/bindings/mmc/sprd,sc7730-sdhci.yaml
```yaml
# SPDX-License-Identifier: (GPL-2.0-only OR BSD-2-Clause)
%YAML 1.2
---
$id: http://devicetree.org/schemas/mmc/sprd,sc7730-sdhci.yaml#
$schema: http://devicetree.org/meta-schemas/core.yaml#

title: Spreadtrum SC7730 SD/SDIO/eMMC host controller

maintainers:
  - Deniz Kokden <koekdendeniz@gmail.com>

description: |
  SDHCI 3.0 compatible hosts of the SC7730 and the other SoCs of the
  SC8830 ("shark") family: SDIO0 to SDIO2 and the eMMC host. Not
  compatible with the later Spreadtrum hosts (sprd,sdhci-r11). The
  capabilities register does not report the base clock and ADMA is not
  supported.

  The base clock comes from a mux in the AP clock block, one 32-bit
  configuration register per host ("clk-cfg" region): bits 1:0 select one
  of four parent clocks, and for SDIO0 bits 10:8 hold an additional divider
  (divide by n + 1).

  Clock gate and soft reset of the hosts are bits in the AP AHB clock
  enable register (EB, offset 0x0) and reset register (RST, offset 0x4),
  for example EB bit 8 / RST bit 11 for SDIO0 and EB bit 9 / RST bit 12
  for SDIO1. These registers are shared with other AP AHB peripherals; the
  optional "ap-ahb" region points there.

  The hosts have programmable delay lines for the data sampling clock,
  which double data rate modes need.

properties:
  compatible:
    const: sprd,sc7730-sdhci

  reg:
    minItems: 2
    items:
      - description: SDHCI registers
      - description: Base clock configuration register of this host
      - description: AP AHB clock enable and reset registers

  reg-names:
    minItems: 2
    items:
      - const: sdhci
      - const: clk-cfg
      - const: ap-ahb

  interrupts:
    maxItems: 1

  clocks:
    maxItems: 1
    description:
      Gate of this host in the AP AHB clock enable register. When given it
      is enabled through the clock framework, which serializes the shared
      register with the other AP AHB blocks, instead of setting
      sprd,ahb-eb-bit directly.

  clock-names:
    const: ahb

  sprd,clk-parent-rates:
    $ref: /schemas/types.yaml#/definitions/uint32-array
    description:
      Rates in Hz of the four parent clocks of the base clock mux, in the
      order of the mux selector (eMMC and SDIO0 26, 256, 312 and 384 MHz,
      SDIO1 48, 76.8, 96 and 128 MHz on the SC7730).
    minItems: 4
    maxItems: 4

  sprd,clk-sel:
    $ref: /schemas/types.yaml#/definitions/uint32
    maximum: 3
    description:
      Parent clock to select in the base clock mux. Without it the
      selection made by the boot loader is kept.

  sprd,clk-has-div:
    type: boolean
    description:
      The base clock configuration register of this host has a divider in
      bits 10:8.

  sprd,ahb-eb-bit:
    $ref: /schemas/types.yaml#/definitions/uint32
    maximum: 31
    description: Bit of this host in the AP AHB clock enable register.

  sprd,ahb-rst-bit:
    $ref: /schemas/types.yaml#/definitions/uint32
    maximum: 31
    description: Bit of this host in the AP AHB soft reset register.

  sprd,write-delay:
    $ref: /schemas/types.yaml#/definitions/uint32
    description: Delay line setting for the write data clock in DDR modes.

  sprd,read-pos-delay:
    $ref: /schemas/types.yaml#/definitions/uint32
    description:
      Delay line setting for sampling read data on the positive clock edge
      in DDR modes.

  sprd,read-neg-delay:
    $ref: /schemas/types.yaml#/definitions/uint32
    description:
      Delay line setting for sampling read data on the negative clock edge
      in DDR modes.

required:
  - compatible
  - reg
  - reg-names
  - interrupts
  - sprd,clk-parent-rates

allOf:
  - $ref: sdhci-common.yaml#
  - if:
      properties:
        reg-names:
          contains:
            const: ap-ahb
    then:
      required:
        - sprd,ahb-eb-bit
        - sprd,ahb-rst-bit
    else:
      properties:
        sprd,ahb-eb-bit: false
        sprd,ahb-rst-bit: false

unevaluatedProperties: false

examples:
  - |
    #include <dt-bindings/interrupt-controller/arm-gic.h>

    mmc@20600000 {
        compatible = "sprd,sc7730-sdhci";
        reg = <0x20600000 0x1000>, <0x71200054 0x4>;
        reg-names = "sdhci", "clk-cfg";
        interrupts = <GIC_SPI 60 IRQ_TYPE_LEVEL_HIGH>;
        sprd,clk-parent-rates = <26000000 256000000 312000000 384000000>;
        bus-width = <8>;
        non-removable;
        no-sd;
        no-sdio;
        no-1-8-v;
        cap-mmc-highspeed;
        mmc-ddr-3_3v;
        max-frequency = <52000000>;
        sprd,write-delay = <0x08>;
        sprd,read-pos-delay = <0x04>;
        sprd,read-neg-delay = <0x04>;
    };

  - |
    #include <dt-bindings/interrupt-controller/arm-gic.h>

    mmc@20300000 {
        compatible = "sprd,sc7730-sdhci";
        reg = <0x20300000 0x1000>, <0x71200048 0x4>, <0x20d00000 0x8>;
        reg-names = "sdhci", "clk-cfg", "ap-ahb";
        interrupts = <GIC_SPI 57 IRQ_TYPE_LEVEL_HIGH>;
        sprd,clk-parent-rates = <26000000 256000000 312000000 384000000>;
        sprd,clk-sel = <3>;
        sprd,clk-has-div;
        sprd,ahb-eb-bit = <8>;
        sprd,ahb-rst-bit = <11>;
        bus-width = <4>;
        no-1-8-v;
        cap-sd-highspeed;
    };
...
```

## Documentation/devicetree/bindings/power/sprd,sc7730-pmu-domains.yaml
```yaml
# SPDX-License-Identifier: (GPL-2.0-only OR BSD-2-Clause)
%YAML 1.2
---
$id: http://devicetree.org/schemas/power/sprd,sc7730-pmu-domains.yaml#
$schema: http://devicetree.org/meta-schemas/core.yaml#

title: Spreadtrum SC7730 PMU power domains

maintainers:
  - Deniz Kokden <koekdendeniz@gmail.com>

description: |
  Power domains of the SC7730 power management unit. Each domain has a
  configuration register in the PMU block with a forced shutdown bit, an
  automatic shutdown bit and power-up delays, and a 4-bit state in
  PWR_STATUS0_DBG. Behind each domain sits a bus enable bit in the AON APB
  clock enable register EB0 (offset 0x0), which is shared with other
  always-on peripherals.

  The power domain specifier is the domain index -
    0 - GPU_TOP, the Mali-400 MP2 GPU (AON APB EB0 bit 27)
    1 - MM_TOP, the multimedia domain with camera capture (DCAM, CSI-2)
        and video blocks (AON APB EB0 bit 25)

properties:
  compatible:
    const: sprd,sc7730-pmu-domains

  reg:
    items:
      - description: PMU registers
      - description: AON APB clock enable register EB0

  reg-names:
    items:
      - const: pmu
      - const: aon-apb

  '#power-domain-cells':
    const: 1

required:
  - compatible
  - reg
  - reg-names
  - '#power-domain-cells'

additionalProperties: false

examples:
  - |
    power-controller@402b0000 {
        compatible = "sprd,sc7730-pmu-domains";
        reg = <0x402b0000 0x100>, <0x402e0000 0x4>;
        reg-names = "pmu", "aon-apb";
        #power-domain-cells = <1>;
    };
...
```

## Documentation/devicetree/bindings/power/supply/sprd,sc2723-fgu-polled.yaml
```yaml
# SPDX-License-Identifier: (GPL-2.0-only OR BSD-2-Clause)
%YAML 1.2
---
$id: http://devicetree.org/schemas/power/supply/sprd,sc2723-fgu-polled.yaml#
$schema: http://devicetree.org/meta-schemas/core.yaml#

title: Spreadtrum SC2723 PMIC fuel gauge, polled

maintainers:
  - Deniz Kokden <koekdendeniz@gmail.com>

description: |
  The fuel gauge unit (FGU) of the SC2723 PMIC (registers at offset 0x500
  of the PMIC). It measures the battery voltage and the current through a
  sense resistor (nominally 20 mOhm) and integrates the current in a
  coulomb counter. Its ADC is calibrated by two points stored in the PMIC
  eFuse. An always-on user register keeps the last state of charge
  across reboots.

  This node describes the FGU read periodically, without its interrupt.
  The battery thermistor is not part of the FGU; it is read through an ADC
  channel and converted with a board specific table. The full description
  of the FGU as a function of the SC2723 PMIC on the ADI bus is
  sprd,sc2723-fgu (power/supply/sc27xx-fg.yaml).

allOf:
  - $ref: power-supply.yaml#

properties:
  compatible:
    const: sprd,sc2723-fgu-polled

  monitored-battery: true

  sprd,calib-resistance-micro-ohms:
    description:
      Real resistance of the coulomb counter sense resistor in micro Ohms.
    default: 20000

  io-channels:
    items:
      - description: ADC channel of the battery thermistor

  io-channel-names:
    items:
      - const: bat-temp

  sprd,bat-temp-table:
    $ref: /schemas/types.yaml#/definitions/int32-matrix
    minItems: 2
    items:
      items:
        - description: ADC reading of the thermistor channel (raw counts)
        - description: Battery temperature in 0.1 degrees Celsius
    description:
      Conversion table from the thermistor channel's ADC reading to the
      battery temperature, sorted by ADC reading. Values in between are
      interpolated linearly.

  sprd,charge-stop-celsius:
    items:
      - description: Battery temperature below which charging is stopped
      - description: Battery temperature above which charging is stopped

  sprd,charge-resume-celsius:
    items:
      - description:
          Battery temperature above which stopped charging is resumed
          (lower end of the window)
      - description:
          Battery temperature below which stopped charging is resumed
          (upper end of the window)

dependencies:
  sprd,bat-temp-table:
    - io-channels
    - io-channel-names
  io-channels:
    - sprd,bat-temp-table
  sprd,charge-stop-celsius:
    - sprd,bat-temp-table
    - sprd,charge-resume-celsius
  sprd,charge-resume-celsius:
    - sprd,charge-stop-celsius

required:
  - compatible
  - monitored-battery

unevaluatedProperties: false

examples:
  - |
    fuel-gauge {
        compatible = "sprd,sc2723-fgu-polled";
        monitored-battery = <&battery>;
        power-supplies = <&charger>;
        sprd,calib-resistance-micro-ohms = <20200>;
        io-channels = <&pmic_adc 1>;
        io-channel-names = "bat-temp";
        sprd,bat-temp-table = <653 700>, <1549 400>, <2392 200>,
                              <3040 0>, <3360 (-100)>, <3537 (-200)>;
        sprd,charge-stop-celsius = <(-5) 58>;
        sprd,charge-resume-celsius = <0 53>;
    };
...
```

## Documentation/devicetree/bindings/pwm/sprd,sc8830-pwm.yaml
```yaml
# SPDX-License-Identifier: (GPL-2.0-only OR BSD-2-Clause)
%YAML 1.2
---
$id: http://devicetree.org/schemas/pwm/sprd,sc8830-pwm.yaml#
$schema: http://devicetree.org/meta-schemas/core.yaml#

title: Spreadtrum SC8830/SC7730 always-on PWM controller

maintainers:
  - Deniz Kokden <koekdendeniz@gmail.com>

description: |
  Four PWM channels in the always-on domain of the SC7730 and the other
  SoCs of the SC8830 ("shark") family, 0x20 apart. Each channel has an
  8-bit prescaler and an 8-bit counter with modulus and duty fields:
  period = (prescale + 1) * modulus / rate. A channel stops with its
  output low. Not compatible with the PWM controller of the UMS512
  (sprd,ums512-pwm), which has separate modulus, duty and enable registers.

  The channel clock gates are bits 4 to 7 of the AON APB clock enable
  register EB0, and each channel has a clock select register (bit 0 set
  selects the 26 MHz clock) in the AON clock block. Both are shared with
  other always-on peripherals; the optional "aon-apb" and "clk-sel"
  regions point there.

allOf:
  - $ref: pwm.yaml#

properties:
  compatible:
    const: sprd,sc8830-pwm

  reg:
    minItems: 1
    items:
      - description: PWM channel registers
      - description: AON APB clock enable register (EB0)
      - description: Clock select registers of channels 0 to 3

  reg-names:
    minItems: 1
    items:
      - const: pwm
      - const: aon-apb
      - const: clk-sel

  clocks:
    maxItems: 1
    description: Source clock of the counters (26 MHz)

  '#pwm-cells':
    const: 3

required:
  - compatible
  - reg
  - reg-names
  - clocks

unevaluatedProperties: false

examples:
  - |
    pwm@40260000 {
        compatible = "sprd,sc8830-pwm";
        reg = <0x40260000 0x80>, <0x402e0000 0x4>, <0x402d0038 0x10>;
        reg-names = "pwm", "aon-apb", "clk-sel";
        clocks = <&ext_26m>;
        #pwm-cells = <3>;
    };
...
```

## Documentation/devicetree/bindings/regulator/sprd,sc2723-dcdc-arm.yaml
```yaml
# SPDX-License-Identifier: (GPL-2.0-only OR BSD-2-Clause)
%YAML 1.2
---
$id: http://devicetree.org/schemas/regulator/sprd,sc2723-dcdc-arm.yaml#
$schema: http://devicetree.org/meta-schemas/core.yaml#

title: Spreadtrum SC2723 PMIC DCDC_ARM regulator

maintainers:
  - Deniz Kokden <koekdendeniz@gmail.com>

description: |
  DCDC_ARM of the SC2723 PMIC, the supply of the Cortex-A7 cluster of the
  SC7730. Its output is set in DCDC_ARM_ADI (offset 0xa04 in the PMIC).
  While MIXED_CTRL0 (offset 0x918) bit 14 is clear, the mode the boot
  loaders set up, bits 7:5 select a base voltage (1100, 700, 800, 900,
  1000, 650, 1200 and 1300 mV for the values 0 to 7) and bits 4:0 add
  3.125 mV steps on top. The regulator is always on.

allOf:
  - $ref: regulator.yaml#

properties:
  compatible:
    const: sprd,sc2723-dcdc-arm

required:
  - compatible

unevaluatedProperties: false

examples:
  - |
    regulator-vddarm {
        compatible = "sprd,sc2723-dcdc-arm";
        regulator-name = "vddarm";
        regulator-min-microvolt = <900000>;
        regulator-max-microvolt = <1200000>;
        regulator-always-on;
        regulator-boot-on;
    };
...
```

## Documentation/devicetree/bindings/regulator/sprd,sc2723-ldo.yaml
```yaml
# SPDX-License-Identifier: (GPL-2.0-only OR BSD-2-Clause)
%YAML 1.2
---
$id: http://devicetree.org/schemas/regulator/sprd,sc2723-ldo.yaml#
$schema: http://devicetree.org/meta-schemas/core.yaml#

title: Spreadtrum SC2723 PMIC LDO regulator

maintainers:
  - Deniz Kokden <koekdendeniz@gmail.com>

description: |
  One LDO regulator of the SC2723 PMIC. Each LDO is switched by a
  power-down bit (set means off) and set by a voltage field, both in PMIC
  registers that several LDOs share; the output voltage is
  sprd,min-microvolt + n * sprd,step-microvolt for the field value n.
  For example LDO_SDCORE has its power-down bit 10 at offset 0x814 and its
  voltage in bits 15:8 at offset 0x830, LDO_CAMIO bit 6 at 0x814 and bits
  14:8 at 0x81c.

allOf:
  - $ref: regulator.yaml#

properties:
  compatible:
    const: sprd,sc2723-ldo

  sprd,pd-reg:
    $ref: /schemas/types.yaml#/definitions/uint32-array
    items:
      - description: Offset of the power-down register in the PMIC
      - description: Bit number of this LDO in it
        maximum: 15
    description: Power-down bit of the LDO, set means off.

  sprd,vsel-reg:
    $ref: /schemas/types.yaml#/definitions/uint32-array
    items:
      - description: Offset of the voltage register in the PMIC
      - description: Mask of the voltage field of this LDO in it
        minimum: 1
        maximum: 0xffff
    description: Voltage field of the LDO.

  sprd,min-microvolt:
    description: Output voltage at field value 0.
    default: 1200000

  sprd,step-microvolt:
    description: Voltage step per field value.
    default: 10000

required:
  - compatible
  - regulator-name
  - sprd,pd-reg
  - sprd,vsel-reg

unevaluatedProperties: false

examples:
  - |
    regulator-vddcamio {
        compatible = "sprd,sc2723-ldo";
        regulator-name = "vddcamio";
        sprd,pd-reg = <0x814 6>;
        sprd,vsel-reg = <0x81c 0x7f00>;
        sprd,min-microvolt = <1150000>;
        sprd,step-microvolt = <6250>;
        regulator-min-microvolt = <1800000>;
        regulator-max-microvolt = <1800000>;
    };
...
```
