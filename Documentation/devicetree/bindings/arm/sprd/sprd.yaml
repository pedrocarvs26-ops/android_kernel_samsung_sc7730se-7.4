## Documentation/devicetree/bindings/arm/sprd/sprd.yaml
```yaml
# SPDX-License-Identifier: (GPL-2.0-only OR BSD-2-Clause)
# Copyright 2019 Unisoc Inc.
%YAML 1.2
---
$id: http://devicetree.org/schemas/arm/sprd/sprd.yaml#
$schema: http://devicetree.org/meta-schemas/core.yaml#

title: Unisoc platforms

maintainers:
  - Orson Zhai <orsonzhai@gmail.com>
  - Baolin Wang <baolin.wang7@gmail.com>
  - Chunyan Zhang <zhang.lyra@gmail.com>

properties:
  $nodename:
    const: '/'
  compatible:
    oneOf:
      - items:
          - enum:
              - samsung,gtelwifi # Samsung Galaxy Tab E 9.6 WiFi (SM-T560)
          - const: sprd,sc7730
      - items:
          - enum:
              - sprd,sc9836-openphone
          - const: sprd,sc9836
      - items:
          - enum:
              - sprd,sp9860g-1h10
          - const: sprd,sc9860
      - items:
          - enum:
              - sprd,sp9863a-1h10
          - const: sprd,sc9863a

      - items:
          - enum:
              - sprd,ums512-1h10
          - const: sprd,ums512

      - items:
          - enum:
              - sprd,ums9620-2h10
          - const: sprd,ums9620

  sprd,sc-id:
    $ref: /schemas/types.yaml#/definitions/uint32-matrix
    minItems: 1
    maxItems: 16
    items:
      items:
        - description: Chip family ID, 8830 for the SC7730/SC8830 SoCs
        - description:
            Hardware revision of the board (the boot loader's hw_revision);
            the boot loader takes the first entry that matches it exactly
        - description: SoC revision field of the table entry, 0x20000
    description:
      Board identification for the Spreadtrum boot loaders of the SC7730
      (SC8830) generation. They pick the device tree to boot from a table
      appended to the Android boot image (the "dt.img", magic "SPRD", the
      layout of Qualcomm's QCDT version 1) whose entries are built from
      these triplets. One device tree can list several triplets to be used
      on several board revisions. The kernel does not use the property.

additionalProperties: true

...
```

## Documentation/devicetree/bindings/clock/sprd,sc7730-aux0-clk.yaml
```yaml
# SPDX-License-Identifier: (GPL-2.0-only OR BSD-2-Clause)
%YAML 1.2
---
$id: http://devicetree.org/schemas/clock/sprd,sc7730-aux0-clk.yaml#
$schema: http://devicetree.org/meta-schemas/core.yaml#

title: Spreadtrum SC7730 CLK_AUX0 output

maintainers:
  - Deniz Kokden <koekdendeniz@gmail.com>

description: |
  The CLK_AUX0 clock output pad of the SC7730, typically the 32.768 kHz
  low power clock of a WLAN/Bluetooth chip. Its gate is bit 2 of the AON
  APB clock enable register EB1 (offset 0x4) and its source and divider
  are fields of AON_CGM_CFG (offset 0x3020), in the AON APB register block,
  which is shared with other always-on peripherals. The output is the
  32.768 kHz clock, divided by one.

properties:
  compatible:
    const: sprd,sc7730-aux0-clk

  reg:
    maxItems: 1
    description: AON APB register block

  clocks:
    maxItems: 1
    description: The 32.768 kHz clock

  '#clock-cells':
    const: 0

required:
  - compatible
  - reg
  - clocks
  - '#clock-cells'

additionalProperties: false

examples:
  - |
    clock-controller@402e0000 {
        compatible = "sprd,sc7730-aux0-clk";
        reg = <0x402e0000 0x4000>;
        clocks = <&ext_32k>;
        #clock-cells = <0>;
    };
...
```

## Documentation/devicetree/bindings/clock/sprd,sc7730-cpu-clk.yaml
```yaml
# SPDX-License-Identifier: (GPL-2.0-only OR BSD-2-Clause)
%YAML 1.2
---
$id: http://devicetree.org/schemas/clock/sprd,sc7730-cpu-clk.yaml#
$schema: http://devicetree.org/meta-schemas/core.yaml#

title: Spreadtrum SC7730 Cortex-A7 cluster clock

maintainers:
  - Deniz Kokden <koekdendeniz@gmail.com>

description: |
  Clock of the Cortex-A7 cluster of the SC7730. CA7_CKG_CFG in the AP AHB
  block selects the core clock source (bits 2:0, for example the 768 MHz
  TDPLL output or the MPLL) and the AXI and debug dividers (bits 10:8 and
  18:16). The MPLL, used only for the cluster, is set in MPLL_CFG1 in the
  AON APB block, 26 MHz * (NINT + KINT / 2^20) with a 6-bit NINT, which
  limits it to about 1.6 GHz. Both registers sit in blocks shared with
  other peripherals.

properties:
  compatible:
    const: sprd,sc7730-cpu-clk

  reg:
    items:
      - description: CA7_CKG_CFG register
      - description: MPLL_CFG1 register

  reg-names:
    items:
      - const: ckg
      - const: mpll

  '#clock-cells':
    const: 0

required:
  - compatible
  - reg
  - reg-names
  - '#clock-cells'

additionalProperties: false

examples:
  - |
    clock-controller@20d03000 {
        compatible = "sprd,sc7730-cpu-clk";
        reg = <0x20d03000 0x4>, <0x402e3070 0x4>;
        reg-names = "ckg", "mpll";
        #clock-cells = <0>;
    };
...
```

## Documentation/devicetree/bindings/clock/sprd,sc7730-gates.yaml
```yaml
# SPDX-License-Identifier: (GPL-2.0-only OR BSD-2-Clause)
%YAML 1.2
---
$id: http://devicetree.org/schemas/clock/sprd,sc7730-gates.yaml#
$schema: http://devicetree.org/meta-schemas/core.yaml#

title: Spreadtrum SC7730 clock enable register

maintainers:
  - Deniz Kokden <koekdendeniz@gmail.com>

description: |
  A 32-bit register of clock enable bits on the SC7730, one bit per
  peripheral, such as the AP AHB enable register at 0x20d00000 (for
  example bit 4 USB, bit 5 DMA, bits 8 and 9 SDIO0 and SDIO1) or the AP APB
  enable register at 0x71300000 (bits 8 to 12 I2C0 to I2C4, bits 13 to 17
  UART0 to UART4, bits 19 to 22 the INTC blocks). Each bit gates the
  clock of one peripheral; set means running.

  The clock specifier is the bit number. All gates have the parent clock
  given in "clocks" as reference; the actual bus clocks are not modelled.

properties:
  compatible:
    const: sprd,sc7730-gates

  reg:
    maxItems: 1

  clocks:
    maxItems: 1

  '#clock-cells':
    const: 1

required:
  - compatible
  - reg
  - clocks
  - '#clock-cells'

additionalProperties: false

examples:
  - |
    clock-controller@71300000 {
        compatible = "sprd,sc7730-gates";
        reg = <0x71300000 0x4>;
        clocks = <&ext_26m>;
        #clock-cells = <1>;
    };
...
```

## Documentation/devicetree/bindings/display/sprd/sprd,sc7730-dispc.yaml
```yaml
# SPDX-License-Identifier: (GPL-2.0-only OR BSD-2-Clause)
%YAML 1.2
---
$id: http://devicetree.org/schemas/display/sprd/sprd,sc7730-dispc.yaml#
$schema: http://devicetree.org/meta-schemas/core.yaml#

title: Spreadtrum SC7730 display controller (DISPC)

maintainers:
  - Deniz Kokden <koekdendeniz@gmail.com>

description: |
  Display controller of the SC7730 and the other SoCs of the SC8830
  ("shark") family. It reads one image layer and one OSD layer from memory
  without an IOMMU and drives a DPI (video mode) output, which feeds the
  DesignWare MIPI DSI host at 0x21800000.
  Layer registers are double buffered and latch at the next VSYNC. The
  register layout differs from the DPU of the SharkL3 (sprd,sharkl3-dpu).

  The binding describes a DISPC whose clocks, the DSI host, the D-PHY and
  the panel were set up by the boot loader. Its clock gates (AP AHB EB
  bit 1, AON APB EB1 bit 11, AP APB EB bit 18) and clock configuration
  (AP clock registers 0x2c to 0x34) sit in registers shared with other
  peripherals and are only read. The optional "dsi" region gives access to
  the DSI host for panel commands in low power command mode, and
  panel-power-gpios lists the panel's supply switches, so that the panel
  can be switched off and on again.

properties:
  compatible:
    const: sprd,sc7730-dispc

  reg:
    minItems: 5
    items:
      - description: DISPC registers
      - description: AP AHB clock enable register
      - description: AON APB clock enable registers EB0 and EB1
      - description: AP APB clock enable register
      - description: AP clock configuration registers
      - description: DesignWare MIPI DSI host registers

  reg-names:
    minItems: 5
    items:
      - const: dispc
      - const: ap-ahb
      - const: aon-apb
      - const: ap-apb
      - const: ap-clk
      - const: dsi

  interrupts:
    maxItems: 1

  backlight:
    $ref: /schemas/types.yaml#/definitions/phandle
    description: Backlight of the attached panel.

  panel-power-gpios:
    minItems: 1
    maxItems: 3
    description:
      Supply switches of the attached panel, switched on in the listed
      order and off in reverse order.

  width-mm:
    description: Width of the active area of the attached panel in mm.

  height-mm:
    description: Height of the active area of the attached panel in mm.

required:
  - compatible
  - reg
  - reg-names
  - interrupts

allOf:
  - if:
      required:
        - panel-power-gpios
    then:
      properties:
        reg:
          minItems: 6
        reg-names:
          minItems: 6

additionalProperties: false

examples:
  - |
    #include <dt-bindings/gpio/gpio.h>
    #include <dt-bindings/interrupt-controller/arm-gic.h>

    display-controller@20800000 {
        compatible = "sprd,sc7730-dispc";
        reg = <0x20800000 0x1000>, <0x20d00000 0x4>,
              <0x402e0000 0x8>, <0x71300000 0x4>,
              <0x71200000 0x40>, <0x21800000 0x1000>;
        reg-names = "dispc", "ap-ahb", "aon-apb", "ap-apb",
                    "ap-clk", "dsi";
        interrupts = <GIC_SPI 46 IRQ_TYPE_LEVEL_HIGH>;
        backlight = <&backlight>;
        panel-power-gpios = <&gpio 152 GPIO_ACTIVE_HIGH>,
                            <&gpio 232 GPIO_ACTIVE_HIGH>,
                            <&gpio 233 GPIO_ACTIVE_HIGH>;
        width-mm = <129>;
        height-mm = <206>;
    };
...
```

## Documentation/devicetree/bindings/i2c/sprd,sc8830-i2c.yaml
```yaml
# SPDX-License-Identifier: (GPL-2.0-only OR BSD-2-Clause)
%YAML 1.2
---
$id: http://devicetree.org/schemas/i2c/sprd,sc8830-i2c.yaml#
$schema: http://devicetree.org/meta-schemas/core.yaml#

title: Spreadtrum SC8830/SC7730 I2C controller

maintainers:
  - Deniz Kokden <koekdendeniz@gmail.com>

description: |
  I2C controllers of the SC7730 and the other SoCs of the SC8830 ("shark")
  family. Each START, data byte and STOP is issued through a command
  register; there is no FIFO. The SCL rate is derived from the source
  clock with a divider (rate / (4 * (divider + 1))). Not compatible with
  the FIFO based controller of the SC9860 (sprd,sc9860-i2c).

  Clock gate and soft reset of each controller are one bit in the AP APB
  clock enable register (EB, offset 0x0) and the same bit in the AP APB
  reset register (RST, offset 0x4): bits 8 to 12 for I2C0 to I2C4. These
  registers are shared with other AP APB peripherals; the optional
  "ap-apb" region points there and sprd,ap-apb-bit names the bit.

properties:
  compatible:
    const: sprd,sc8830-i2c

  reg:
    minItems: 1
    items:
      - description: Controller registers
      - description: AP APB clock enable and reset registers

  reg-names:
    minItems: 1
    items:
      - const: i2c
      - const: ap-apb

  interrupts:
    maxItems: 1

  clocks:
    maxItems: 1
    description: Source clock of the controller, typically 26 MHz

  clock-frequency:
    default: 100000

  sprd,ap-apb-bit:
    $ref: /schemas/types.yaml#/definitions/uint32
    maximum: 31
    description:
      Bit of this controller in the AP APB clock enable and reset
      registers.

required:
  - compatible
  - reg
  - reg-names
  - clocks

allOf:
  - $ref: /schemas/i2c/i2c-controller.yaml#
  - if:
      properties:
        reg-names:
          contains:
            const: ap-apb
    then:
      required:
        - sprd,ap-apb-bit

unevaluatedProperties: false

examples:
  - |
    i2c@70600000 {
        compatible = "sprd,sc8830-i2c";
        reg = <0x70600000 0x1000>, <0x71300000 0x8>;
        reg-names = "i2c", "ap-apb";
        sprd,ap-apb-bit = <9>;
        clocks = <&ext_26m>;
        clock-frequency = <100000>;
        #address-cells = <1>;
        #size-cells = <0>;

        touchscreen@20 {
            compatible = "zinitix,bt554";
            reg = <0x20>;
            interrupt-parent = <&gpio>;
            interrupts = <82 2>;
            vcca-supply = <&tsp_ldo>;
            touchscreen-size-x = <800>;
            touchscreen-size-y = <1280>;
        };
    };
...
```

## Documentation/devicetree/bindings/iio/adc/sprd,sc2723-adc-polled.yaml
```yaml
# SPDX-License-Identifier: (GPL-2.0-only OR BSD-2-Clause)
%YAML 1.2
---
$id: http://devicetree.org/schemas/iio/adc/sprd,sc2723-adc-polled.yaml#
$schema: http://devicetree.org/meta-schemas/core.yaml#

title: Spreadtrum SC2723 PMIC auxiliary ADC, polled

maintainers:
  - Deniz Kokden <koekdendeniz@gmail.com>

description: |
  The 12-bit auxiliary ADC of the SC2723 PMIC (registers at offset 0x300 of
  the PMIC) with 32 multiplexed inputs, for example the battery thermistor
  on input 1 of the Samsung Galaxy Tab E. This node describes the ADC
  used by software-started single conversions with the completion status
  polled, without its interrupt and without the calibration data in the
  PMIC eFuse; it reports raw readings.

  The full description of the ADC as a function of the SC2723 PMIC on the
  ADI bus is sprd,sc2723-adc (iio/adc/sprd,sc2720-adc.yaml).

properties:
  compatible:
    const: sprd,sc2723-adc-polled

  '#io-channel-cells':
    const: 1

required:
  - compatible
  - '#io-channel-cells'

additionalProperties: false

examples:
  - |
    adc {
        compatible = "sprd,sc2723-adc-polled";
        #io-channel-cells = <1>;
    };
...
```

## Documentation/devicetree/bindings/input/sprd,sc8830-keypad.yaml
```yaml
# SPDX-License-Identifier: (GPL-2.0-only OR BSD-2-Clause)
%YAML 1.2
---
$id: http://devicetree.org/schemas/input/sprd,sc8830-keypad.yaml#
$schema: http://devicetree.org/meta-schemas/core.yaml#

title: Spreadtrum SC8830/SC7730 keypad controller

maintainers:
  - Deniz Kokden <koekdendeniz@gmail.com>

description: |
  Matrix keypad controller in the always-on domain of the SC7730 and the
  other SoCs of the SC8830 ("shark") family. It scans up to 8 rows (KEYOUT)
  and 8 columns (KEYIN) from the 32.768 kHz clock, also while the system
  sleeps, and reports up to four keys at a time with press and release
  interrupts. Rows and columns that carry no key in linux,keymap may be
  muxed to other functions and are not scanned.

  The clock gates (AON APB EB0 bit 8 and RTC_EB bit 1) and the soft reset
  (AON APB RST0 bit 8) are bits in AON APB registers shared with other
  always-on peripherals; the optional "aon-apb" region points there.

allOf:
  - $ref: input.yaml#
  - $ref: /schemas/input/matrix-keymap.yaml#

properties:
  compatible:
    const: sprd,sc8830-keypad

  reg:
    minItems: 1
    items:
      - description: Keypad controller registers
      - description: AON APB clock enable and reset registers

  reg-names:
    minItems: 1
    items:
      - const: kpd
      - const: aon-apb

  interrupts:
    maxItems: 1

  keypad,num-rows:
    maximum: 8

  keypad,num-columns:
    maximum: 8

  autorepeat: true

  wakeup-source:
    type: boolean
    description: Key presses wake the system up.

required:
  - compatible
  - reg
  - reg-names
  - interrupts
  - keypad,num-rows
  - keypad,num-columns
  - linux,keymap

unevaluatedProperties: false

examples:
  - |
    #include <dt-bindings/input/input.h>
    #include <dt-bindings/interrupt-controller/arm-gic.h>

    keypad@40250000 {
        compatible = "sprd,sc8830-keypad";
        reg = <0x40250000 0x1000>, <0x402e0000 0x14>;
        reg-names = "kpd", "aon-apb";
        interrupts = <GIC_SPI 36 IRQ_TYPE_LEVEL_HIGH>;
        keypad,num-rows = <1>;
        keypad,num-columns = <3>;
        linux,keymap = <MATRIX_KEY(0, 1, KEY_HOMEPAGE)
                        MATRIX_KEY(0, 2, KEY_VOLUMEUP)>;
        wakeup-source;
    };
...
```
