## Documentation/devicetree/bindings/sound/sprd,sc2723-codec.yaml
```yaml
# SPDX-License-Identifier: (GPL-2.0-only OR BSD-2-Clause)
%YAML 1.2
---
$id: http://devicetree.org/schemas/sound/sprd,sc2723-codec.yaml#
$schema: http://devicetree.org/meta-schemas/core.yaml#

title: Spreadtrum SC2723 PMIC analog audio codec

maintainers:
  - Deniz Kokden <koekdendeniz@gmail.com>

description: |
  Analog part of the audio codec in the SC2723 PMIC, the companion chip
  of the SC7730/SC8830 SoCs: DACs and ADCs, the headphone, earpiece and
  speaker drivers and the internal class AB/D speaker amplifier. The
  digital part (filters, sample rate) sits in the SoC (sprd,sc7730-vbc),
  connected by an internal link. The codec is a sub-function of the PMIC
  and is accessed through the PMIC's registers (analog block at 0x600,
  global audio enables and resets at 0x800 and up).

allOf:
  - $ref: dai-common.yaml#

properties:
  compatible:
    const: sprd,sc2723-codec

  reg:
    maxItems: 1
    description: Offset of the analog audio registers in the PMIC

  '#sound-dai-cells':
    const: 0

required:
  - compatible
  - reg
  - '#sound-dai-cells'

unevaluatedProperties: false

examples:
  - |
    pmic {
        #address-cells = <1>;
        #size-cells = <0>;

        audio-codec@600 {
            compatible = "sprd,sc2723-codec";
            reg = <0x600>;
            #sound-dai-cells = <0>;
        };
    };
...
```

## Documentation/devicetree/bindings/sound/sprd,sc7730-vbc.yaml
```yaml
# SPDX-License-Identifier: (GPL-2.0-only OR BSD-2-Clause)
%YAML 1.2
---
$id: http://devicetree.org/schemas/sound/sprd,sc7730-vbc.yaml#
$schema: http://devicetree.org/meta-schemas/core.yaml#

title: Spreadtrum SC7730 voice band codec interface (VBC)

maintainers:
  - Deniz Kokden <koekdendeniz@gmail.com>

description: |
  Audio interface of the SC7730 and the other SoCs of the SC8830 ("shark")
  family, used as the CPU DAI. The VBC has two DA FIFOs (left and right,
  16-bit samples, ping-pong halves of 160 frames) and four AD FIFOs, which
  the AP DMA serves on VBC requests. It feeds the digital part of the audio
  codec in the SoC (the "DP": DAC filters, sample rate converters and the
  sigma-delta modulators), which talks to the analog codec in the SC2723
  PMIC over an internal link.

  Clock gates, soft reset and the hand-over of the VBC and its interrupts
  and DMA requests from the modem side are bits in AON APB registers shared
  with other always-on peripherals; the "aon-apb" region points there.

allOf:
  - $ref: dai-common.yaml#

properties:
  compatible:
    const: sprd,sc7730-vbc

  reg:
    items:
      - description: VBC registers (FIFOs and their control)
      - description: Digital audio codec part (DP)
      - description: AON APB registers

  reg-names:
    items:
      - const: vbc
      - const: dp
      - const: aon-apb

  '#sound-dai-cells':
    const: 0

required:
  - compatible
  - reg
  - reg-names
  - '#sound-dai-cells'

unevaluatedProperties: false

examples:
  - |
    audio-controller@40020000 {
        compatible = "sprd,sc7730-vbc";
        reg = <0x40020000 0x1000>, <0x40000000 0x1000>,
              <0x402e0000 0x4000>;
        reg-names = "vbc", "dp", "aon-apb";
        #sound-dai-cells = <0>;
    };
...
```

## Documentation/devicetree/bindings/thermal/sprd,sc7730-thermal.yaml
```yaml
# SPDX-License-Identifier: (GPL-2.0-only OR BSD-2-Clause)
%YAML 1.2
---
$id: http://devicetree.org/schemas/thermal/sprd,sc7730-thermal.yaml#
$schema: http://devicetree.org/meta-schemas/core.yaml#

title: Spreadtrum SC7730 on-die temperature sensor

maintainers:
  - Deniz Kokden <koekdendeniz@gmail.com>

description: |
  Temperature sensor of the SC7730 application processor die. Once enabled
  it converts periodically (for example every 2.25 s); the
  reading is linear in temperature (623 at -40 C, 1030 at 120 C) and can
  raise interrupts at programmable thresholds. Not compatible with the
  multi-sensor controller of the later Spreadtrum SoCs (sprd,ums512-thermal).

  Its clock gate (AON APB EB1 bit 1), its RTC clock gates (RTC_EB bits 10,
  11 and 13) and its soft reset (RST1 bit 1) are bits in AON APB registers
  shared with other always-on peripherals; the "aon-apb" region points
  there.

allOf:
  - $ref: thermal-sensor.yaml#

properties:
  compatible:
    const: sprd,sc7730-thermal

  reg:
    items:
      - description: Temperature sensor registers
      - description: AON APB clock enable and reset registers

  reg-names:
    items:
      - const: thm
      - const: aon-apb

  interrupts:
    maxItems: 1

  '#thermal-sensor-cells':
    const: 0

required:
  - compatible
  - reg
  - reg-names
  - '#thermal-sensor-cells'

unevaluatedProperties: false

examples:
  - |
    thermal-sensor@402f0000 {
        compatible = "sprd,sc7730-thermal";
        reg = <0x402f0000 0x1000>, <0x402e0000 0x4000>;
        reg-names = "thm", "aon-apb";
        #thermal-sensor-cells = <0>;
    };
...
```

## Documentation/devicetree/bindings/timer/sprd,sc8830-timer.yaml
```yaml
# SPDX-License-Identifier: (GPL-2.0-only OR BSD-2-Clause)
%YAML 1.2
---
$id: http://devicetree.org/schemas/timer/sprd,sc8830-timer.yaml#
$schema: http://devicetree.org/meta-schemas/core.yaml#

title: Spreadtrum SC8830/SC7730 general purpose timer

maintainers:
  - Deniz Kokden <koekdendeniz@gmail.com>

description: |
  32-bit timer blocks of the SC7730 and the other SoCs of the SC8830
  ("shark") family, one in the always-on (AON) domain and three in the AP
  domain. Each block has three down-counting channels 0x20 apart, with
  load, value, control, interrupt and shadow counter registers, and one
  interrupt line. The AON block runs from the 32.768 kHz clock.

  Unlike the 64-bit timers of the SC9860 (sprd,sc9860-timer) the counters
  are 32 bits wide and the register layout differs.

  The clock gates of the timers are bits in the AON APB clock enable
  register EB0 (AON timer bit 11, AP timer 0 bit 12, system counter bit
  10), which is shared with other AON peripherals; the optional "aon-apb"
  region points there.

properties:
  compatible:
    const: sprd,sc8830-timer

  reg:
    minItems: 1
    items:
      - description: Timer block (three channels)
      - description: AON APB clock enable registers

  reg-names:
    minItems: 1
    items:
      - const: timer
      - const: aon-apb

  interrupts:
    maxItems: 1

  clock-frequency:
    description: Rate of the timer clock in Hz.
    default: 32768

required:
  - compatible
  - reg
  - interrupts

additionalProperties: false

examples:
  - |
    #include <dt-bindings/interrupt-controller/arm-gic.h>

    timer@40050000 {
        compatible = "sprd,sc8830-timer";
        reg = <0x40050000 0x60>, <0x402e0000 0x10>;
        reg-names = "timer", "aon-apb";
        interrupts = <GIC_SPI 28 IRQ_TYPE_LEVEL_HIGH>;
        clock-frequency = <32768>;
    };
...
```

## arch/arm/Kconfig.platforms
```kconfig
# SPDX-License-Identifier: GPL-2.0-only

menu "Platform selection"
	depends on MMU

comment "CPU Core family selection"

config ARCH_MULTI_V4
	bool "ARMv4 based platforms (FA526, StrongARM)"
	depends on !ARCH_MULTI_V6_V7
	select ARCH_MULTI_V4_V5
	select CPU_FA526 if !(CPU_SA110 || CPU_SA1100)

config ARCH_MULTI_V4T
	bool "ARMv4T based platforms (ARM720T, ARM920T, ...)"
	depends on !ARCH_MULTI_V6_V7
	select ARCH_MULTI_V4_V5
	select CPU_ARM920T if !(CPU_ARM7TDMI || CPU_ARM720T || \
		CPU_ARM740T || CPU_ARM9TDMI || CPU_ARM922T || \
		CPU_ARM925T || CPU_ARM940T)

config ARCH_MULTI_V5
	bool "ARMv5 based platforms (ARM926T, XSCALE, PJ1, ...)"
	depends on !ARCH_MULTI_V6_V7
	select ARCH_MULTI_V4_V5
	select CPU_ARM926T if !(CPU_ARM946E || CPU_ARM1020 || \
		CPU_ARM1020E || CPU_ARM1022 || CPU_ARM1026 || \
		CPU_XSCALE || CPU_XSC3 || CPU_MOHAWK || CPU_FEROCEON)

config ARCH_MULTI_V4_V5
	bool

config ARCH_MULTI_V6
	bool "ARMv6 based platforms (ARM11)"
	select ARCH_MULTI_V6_V7
	select CPU_ARM1176

config ARCH_MULTI_V7
	bool "ARMv7 based platforms (Cortex-A, PJ4, Scorpion, Krait)"
	default y
	select ARCH_MULTI_V6_V7
	select CPU_V7
	select HAVE_SMP

config ARCH_MULTI_V6_V7
	bool
	select MIGHT_HAVE_CACHE_L2X0

config ARCH_MULTI_CPU_AUTO
	def_bool !(ARCH_MULTI_V4 || ARCH_MULTI_V4T || ARCH_MULTI_V6_V7)
	select ARCH_MULTI_V5

endmenu

config ARCH_VIRT
	bool "Dummy Virtual Machine"
	depends on ARCH_MULTI_V7
	select ARM_AMBA
	select ARM_GIC
	select ARM_GIC_V2M if PCI
	select ARM_GIC_V3
	select ARM_GIC_V3_ITS if PCI
	select ARM_PSCI
	select HAVE_ARM_ARCH_TIMER

config ARCH_AIROHA
	bool "Airoha SoC Support"
	depends on ARCH_MULTI_V7
	select ARM_AMBA
	select ARM_GIC
	select ARM_GIC_V3
	select ARM_PSCI
	select HAVE_ARM_ARCH_TIMER
	help
	  Support for Airoha EN7523 SoCs

config MACH_ASM9260
	bool "Alphascale ASM9260"
	depends on ARCH_MULTI_V5
	depends on CPU_LITTLE_ENDIAN
	select CPU_ARM926T
	select ASM9260_TIMER
	help
	  Support for Alphascale ASM9260 based platform.

menuconfig ARCH_HPE
	bool "HPE SoC support"
	depends on ARCH_MULTI_V7
	help
	  This enables support for HPE ARM based BMC chips.

if ARCH_HPE

config ARCH_HPE_GXP
	bool "HPE GXP SoC"
	depends on ARCH_MULTI_V7
	select ARM_VIC
	select GENERIC_IRQ_CHIP
	select CLKSRC_MMIO
	help
	  HPE GXP is the name of the HPE Soc. This SoC is used to implement many
	  BMC features at HPE. It supports ARMv7 architecture based on the Cortex
	  A9 core. It is capable of using an AXI bus to which a memory controller
	  is attached. It has multiple SPI interfaces to connect boot flash and
	  BIOS flash. It uses a 10/100/1000 MAC for network connectivity. It
	  has multiple i2c engines to drive connectivity with a host
	  infrastructure.

endif

menuconfig ARCH_MOXART
	bool "MOXA ART SoC"
	depends on ARCH_MULTI_V4
	depends on CPU_LITTLE_ENDIAN
	select CPU_FA526
	select ARM_DMA_MEM_BUFFERABLE
	select FARADAY_FTINTC010
	select FTTMR010_TIMER
	select GPIOLIB
	select PHYLIB if NETDEVICES
	help
	  Say Y here if you want to run your kernel on hardware with a
	  MOXA ART SoC.
	  The MOXA ART SoC is based on a Faraday FA526 ARMv4 32-bit
	  192 MHz CPU with MMU and 16KB/8KB D/I-cache (UC-7112-LX).
	  Used on models UC-7101, UC-7112/UC-7110, IA240/IA241, IA3341.

if ARCH_MOXART

config MACH_UC7112LX
	bool "MOXA UC-7112-LX"
	depends on ARCH_MOXART
	help
	  Say Y here if you intend to run this kernel on a MOXA
	  UC-7112-LX embedded computer.

endif

config ARCH_NSPIRE
	bool "TI-NSPIRE based"
	depends on ARCH_MULTI_V4T
	depends on CPU_LITTLE_ENDIAN
	select CPU_ARM926T
	select GENERIC_IRQ_CHIP
	select ARM_AMBA
	select ARM_VIC
	select ARM_TIMER_SP804
	select NSPIRE_TIMER
	select POWER_RESET
	select POWER_RESET_SYSCON
	help
	  This enables support for systems using the TI-NSPIRE CPU

config ARCH_RDA
	bool "RDA Micro SoCs"
	depends on ARCH_MULTI_V7
	select RDA_INTC
	select RDA_TIMER
	help
	  This enables support for the RDA Micro 8810PL SoC family.

config ARCH_SPRD
	bool "Spreadtrum/Unisoc 32-bit SoCs (SC7730/SC8830 \"shark\")"
	depends on ARCH_MULTI_V7
	select ARM_GIC
	select HAVE_ARM_ARCH_TIMER
	select SPRD_SC8830_INTC
	select SPRD_SC8830_TIMER
	help
	  Support for the 32-bit Spreadtrum SC7730/SC8830 ("scx35"/"shark")
	  family, e.g. the Samsung Galaxy Tab E 9.6 (SM-T560, gtelwifi).

config SPRD_BOOTSTRIPES
	bool "Paint boot progress stripes into the bootloader framebuffer"
	depends on ARCH_SPRD
	help
	  Debug aid for bring-up without a serial console. The Spreadtrum
	  bootloader passes the scan-out buffer of its splash screen as
	  "lcd_base=<hex>" on the command line. With this option the kernel
	  reserves that buffer and paints a white band for every boot stage
	  it reaches, so a photo of the screen shows where boot stopped.

config SPRD_USB_BRINGUP
	bool "Power up the SC7730 USB PHY for dwc2 (bring-up hack)"
	depends on ARCH_SPRD && USB_DWC2
	select SPRD_ADI
	help
	  Switches on the SC2723 USB LDO, the USB PHY, its AHB clock and
	  resets, then writes the PHY tune value, following the vendor
	  kernel. Stop-gap until clock, PHY and regulator drivers exist.

config SPRD_RESTART
	bool "Restart through the SC2723 PMIC watchdog"
	depends on ARCH_SPRD
	select SPRD_ADI
	help
	  Restart handler for the SC7730: leaves the boot mode for the
	  bootloader ("reboot recovery" boots the recovery partition) and
	  lets the PMIC watchdog reset the system, as the vendor kernel does.

config SPRD_PMIC_EIC
	bool "SC2723 PMIC EIC inputs as polled GPIOs (bring-up glue)"
	depends on ARCH_SPRD && GPIOLIB
	select SPRD_ADI
	help
	  The power and volume down keys of SC7730 tablets hang off the
	  EIC block of the SC2723 PMIC behind the ADI bus. This exposes
	  its 16 inputs as a GPIO chip without interrupts, for
	  gpio-keys-polled, until the mainline sc27xx drivers support
	  the SC2723.

config SPRD_CLK_AUX0
	bool "SC7730 CLK_AUX0 32 kHz output (bring-up glue)"
	depends on ARCH_SPRD && COMMON_CLK
	help
	  Gate clock for the CLK_AUX0 pad, the 32 kHz low power clock of
	  the Broadcom WLAN chip on the Galaxy Tab E. Stop-gap until there
	  is a clock driver for the SC7730.

config SPRD_SC2723_FGU
	bool "SC2723 PMIC fuel gauge as battery supply (bring-up glue)"
	depends on ARCH_SPRD && POWER_SUPPLY
	select SPRD_ADI
	help
	  Battery voltage, current and state of charge from the fuel gauge
	  of the SC2723 PMIC, polled over the ADI bus, until the mainline
	  sc27xx drivers support the SC2723.

config SPRD_ADI
	bool

menuconfig ARCH_SUNPLUS
	bool "Sunplus SoCs"
	depends on ARCH_MULTI_V7
	help
	  Support for Sunplus SoC family: SP7021 and succeeding SoC-based systems,
	  such as the Banana Pi BPI-F2S development board (and derivatives).
	  (<http://www.sinovoip.com.cn/ecp_view.asp?id=586>)
	  (<https://tibbo.com/store/plus1.html>)

if ARCH_SUNPLUS

config SOC_SP7021
	bool "Sunplus SP7021 SoC support"
	default ARCH_SUNPLUS
	select HAVE_ARM_ARCH_TIMER
	select ARM_GIC
	select ARM_PSCI
	select PINCTRL
	select PINCTRL_SPPCTL
	select SERIAL_SUNPLUS if TTY
	select SERIAL_SUNPLUS_CONSOLE if TTY
	help
	  Support for Sunplus SP7021 SoC. It is based on ARM 4-core
	  Cortex-A7 with various peripherals (e.g.: I2C, SPI, SDIO,
	  Ethernet, etc.), FPGA interface,  chip-to-chip bus.
	  It is designed for industrial control.

endif

config ARCH_UNIPHIER
	bool "Socionext UniPhier SoCs"
	depends on ARCH_MULTI_V7
	select ARCH_HAS_RESET_CONTROLLER
	select ARM_AMBA
	select ARM_GLOBAL_TIMER
	select ARM_GIC
	select HAVE_ARM_SCU
	select HAVE_ARM_TWD if SMP
	select PINCTRL
	select RESET_CONTROLLER
	help
	  Support for UniPhier SoC family developed by Socionext Inc.
	  (formerly, System LSI Business Division of Panasonic Corporation)
```

## drivers/gpu/drm/sprd/Kconfig
```kconfig
config DRM_SPRD
	tristate "DRM Support for Unisoc SoCs Platform"
	depends on ARCH_SPRD || COMPILE_TEST
	depends on DRM && OF
	select DRM_GEM_DMA_HELPER
	select DRM_KMS_HELPER
	select DRM_MIPI_DSI
	select VIDEOMODE_HELPERS
	help
	  Choose this option if you have a Unisoc chipset.
	  If M is selected the module will be called sprd_drm.


config DRM_SPRD_DISPC
	tristate "Spreadtrum SC7730/SC8830 display controller (takeover)"
	depends on ARCH_SPRD || COMPILE_TEST
	depends on DRM && OF && MMU
	depends on BACKLIGHT_CLASS_DEVICE || !BACKLIGHT_CLASS_DEVICE
	select APERTURE_HELPERS
	select DRM_CLIENT_SELECTION
	select DRM_GEM_DMA_HELPER
	select DRM_KMS_HELPER
	help
	  DRM driver for the DISPC of the 32-bit Spreadtrum SC7730/SC8830
	  ("shark") SoCs, e.g. in the Samsung Galaxy Tab E 9.6. It takes
	  over the DSI video-mode pipeline the bootloader leaves running and
	  only flips the scan-out buffer; DSI and the panel are not driven.

	  If M is selected the module will be called sprd_dispc.
```
