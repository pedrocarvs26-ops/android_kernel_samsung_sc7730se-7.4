## Documentation/devicetree/bindings/interrupt-controller/sprd,sc8830-intc.yaml
```yaml
# SPDX-License-Identifier: (GPL-2.0-only OR BSD-2-Clause)
%YAML 1.2
---
$id: http://devicetree.org/schemas/interrupt-controller/sprd,sc8830-intc.yaml#
$schema: http://devicetree.org/meta-schemas/core.yaml#

title: Spreadtrum SC8830/SC7730 interrupt wake-up gates (INTC)

maintainers:
  - Deniz Kokden <koekdendeniz@gmail.com>

description: |
  The SC7730 and the other SoCs of the SC8830 ("shark") family put four
  INTC blocks in front of the GIC. Every shared peripheral interrupt also
  passes through an enable bit in one of them: INTC n covers SPI 32n to
  32n + 31, the bit number is the SPI number modulo 32, bits 0 and 1 of
  each block are not wired. Interrupts reach the GIC whether the bit is
  set or not, but once all cores are in WFI the GIC clock stops, and only
  interrupts enabled in an INTC block wake a core up again.

  Each block has an IRQ enable register at offset 0x8 and an IRQ disable
  register at 0xc. The clock gates of the four blocks are bits 19 to 22 of
  the AP APB clock enable register; the optional fifth register region
  points there, so that the blocks are clocked before they are written.
  That register is shared with the enable bits of other AP APB
  peripherals.

  The controller is stacked on the GIC and uses the same interrupt
  specifier.

properties:
  compatible:
    const: sprd,sc8830-intc

  reg:
    minItems: 4
    items:
      - description: INTC0, SPI 0-31
      - description: INTC1, SPI 32-63
      - description: INTC2, SPI 64-95
      - description: INTC3, SPI 96-127
      - description: AP APB clock enable register (EB)

  interrupt-controller: true

  '#interrupt-cells':
    const: 3
    description: The cells have the same encoding as defined in arm,gic.yaml.

required:
  - compatible
  - reg
  - interrupt-controller
  - '#interrupt-cells'

allOf:
  - $ref: /schemas/interrupt-controller.yaml#

unevaluatedProperties: false

examples:
  - |
    interrupt-controller@71400000 {
        compatible = "sprd,sc8830-intc";
        reg = <0x71400000 0x1000>, <0x71500000 0x1000>,
              <0x71600000 0x1000>, <0x71700000 0x1000>,
              <0x71300000 0x4>;
        interrupt-parent = <&gic>;
        interrupt-controller;
        #interrupt-cells = <3>;
    };
...
```

## Documentation/devicetree/bindings/media/i2c/samsung,s5k4ecgx.yaml
```yaml
# SPDX-License-Identifier: (GPL-2.0-only OR BSD-2-Clause)
%YAML 1.2
---
$id: http://devicetree.org/schemas/media/i2c/samsung,s5k4ecgx.yaml#
$schema: http://devicetree.org/meta-schemas/core.yaml#

title: Samsung S5K4ECGX 5 MP CMOS image sensor

maintainers:
  - Deniz Kokden <koekdendeniz@gmail.com>

description:
  The Samsung S5K4ECGX is a 5 megapixel (2560 x 1920) CMOS image sensor
  with an integrated image signal processor and autofocus control that
  outputs YCbCr 4:2:2 or JPEG over a two-lane MIPI CSI-2 interface.
  It is controlled over I2C with 16-bit registers, most of its settings
  being written indirectly into its internal memory. It needs a separate
  1.2 V core supply and has a reset and a standby input.

allOf:
  - $ref: /schemas/media/video-interface-devices.yaml#

properties:
  compatible:
    const: samsung,s5k4ecgx

  reg:
    maxItems: 1

  clocks:
    maxItems: 1
    description: Master clock (MCLK), 24 MHz

  avdd-supply:
    description: Analog supply, 2.8 V

  dovdd-supply:
    description: Digital I/O supply, 1.8 V

  dvdd-supply:
    description: Digital core supply, 1.2 V

  reset-gpios:
    maxItems: 1
    description: Reset input, active low

  powerdown-gpios:
    maxItems: 1
    description: Standby input, active low

  orientation: true

  rotation: true

  port:
    $ref: /schemas/graph.yaml#/$defs/port-base
    additionalProperties: false

    properties:
      endpoint:
        $ref: /schemas/media/video-interfaces.yaml#
        unevaluatedProperties: false

        properties:
          data-lanes:
            items:
              - const: 1
              - const: 2

          link-frequencies: true

        required:
          - data-lanes

    required:
      - endpoint

required:
  - compatible
  - reg
  - clocks
  - avdd-supply
  - dovdd-supply
  - dvdd-supply
  - reset-gpios
  - powerdown-gpios
  - port

additionalProperties: false

examples:
  - |
    #include <dt-bindings/gpio/gpio.h>

    i2c {
        #address-cells = <1>;
        #size-cells = <0>;

        camera@56 {
            compatible = "samsung,s5k4ecgx";
            reg = <0x56>;
            clocks = <&dcam>;
            avdd-supply = <&vddcama>;
            dovdd-supply = <&vddcamio>;
            dvdd-supply = <&cam_dvdd>;
            reset-gpios = <&gpio 186 GPIO_ACTIVE_LOW>;
            powerdown-gpios = <&gpio 188 GPIO_ACTIVE_LOW>;
            orientation = <1>;
            rotation = <270>;

            port {
                endpoint {
                    remote-endpoint = <&dcam_rear_in>;
                    data-lanes = <1 2>;
                };
            };
        };
    };
...
```

## Documentation/devicetree/bindings/media/i2c/siliconfile,sr200pc20m.yaml
```yaml
# SPDX-License-Identifier: (GPL-2.0-only OR BSD-2-Clause)
%YAML 1.2
---
$id: http://devicetree.org/schemas/media/i2c/siliconfile,sr200pc20m.yaml#
$schema: http://devicetree.org/meta-schemas/core.yaml#

title: SiliconFile SR200PC20M 2 MP CMOS image sensor

maintainers:
  - Deniz Kokden <koekdendeniz@gmail.com>

description:
  The SiliconFile SR200PC20M is a 2 megapixel (1600 x 1200) CMOS image
  sensor with an integrated image signal processor that outputs YCbCr 4:2:2
  over a one-lane MIPI CSI-2 interface. It is controlled over I2C with
  8-bit registers in pages and has a reset and a standby input.

allOf:
  - $ref: /schemas/media/video-interface-devices.yaml#

properties:
  compatible:
    const: siliconfile,sr200pc20m

  reg:
    maxItems: 1

  clocks:
    maxItems: 1
    description: Master clock (MCLK), 24 MHz

  avdd-supply:
    description: Analog supply, 2.8 V

  dovdd-supply:
    description: Digital I/O supply, 1.8 V

  reset-gpios:
    maxItems: 1
    description: Reset input, active low

  powerdown-gpios:
    maxItems: 1
    description: Standby input, active low

  orientation: true

  rotation: true

  port:
    $ref: /schemas/graph.yaml#/$defs/port-base
    additionalProperties: false

    properties:
      endpoint:
        $ref: /schemas/media/video-interfaces.yaml#
        unevaluatedProperties: false

        properties:
          data-lanes:
            items:
              - const: 1

          link-frequencies: true

        required:
          - data-lanes

    required:
      - endpoint

required:
  - compatible
  - reg
  - clocks
  - avdd-supply
  - dovdd-supply
  - reset-gpios
  - powerdown-gpios
  - port

additionalProperties: false

examples:
  - |
    #include <dt-bindings/gpio/gpio.h>

    i2c {
        #address-cells = <1>;
        #size-cells = <0>;

        camera@20 {
            compatible = "siliconfile,sr200pc20m";
            reg = <0x20>;
            clocks = <&dcam>;
            avdd-supply = <&vddcama>;
            dovdd-supply = <&vddcamio>;
            reset-gpios = <&gpio 238 GPIO_ACTIVE_LOW>;
            powerdown-gpios = <&gpio 187 GPIO_ACTIVE_LOW>;
            orientation = <0>;
            rotation = <90>;

            port {
                endpoint {
                    remote-endpoint = <&dcam_front_in>;
                    data-lanes = <1>;
                };
            };
        };
    };
...
```

## Documentation/devicetree/bindings/media/sprd,sc7730-dcam.yaml
```yaml
# SPDX-License-Identifier: (GPL-2.0-only OR BSD-2-Clause)
%YAML 1.2
---
$id: http://devicetree.org/schemas/media/sprd,sc7730-dcam.yaml#
$schema: http://devicetree.org/meta-schemas/core.yaml#

title: Spreadtrum SC7730 camera capture (DCAM and CSI-2 receiver)

maintainers:
  - Deniz Kokden <koekdendeniz@gmail.com>

description: |
  Camera capture of the SC7730 and the other SoCs of the SC8830 ("shark")
  family: a Synopsys DesignWare MIPI CSI-2 host (version 1.03) with two
  D-PHYs, D-PHY A with up to two data lanes and D-PHY C with one, and the
  DCAM capture engine, which writes the received frames to memory (YUV
  4:2:0 or 4:2:2 semi-planar, optionally scaled). Only one D-PHY receives
  at a time.

  The block sits in the MM power domain. Its bus gates, resets and the
  CSI-2 D-PHY selection are bits in the MM AHB registers, its clocks
  (including the master clock MCLK for the image sensors, 24 MHz) are set
  in the MM clock registers, and the power-down bit of D-PHY A is in the
  AON APB power control register. All three register blocks are shared
  with other blocks.

properties:
  compatible:
    const: sprd,sc7730-dcam

  reg:
    items:
      - description: DCAM registers
      - description: CSI-2 host registers
      - description: MM AHB registers (bus gates and resets)
      - description: MM clock configuration registers
      - description: AON APB registers

  reg-names:
    items:
      - const: dcam
      - const: csi
      - const: mm-ahb
      - const: mm-clk
      - const: aon-apb

  interrupts:
    maxItems: 1

  power-domains:
    maxItems: 1

  '#clock-cells':
    const: 0
    description: The sensor master clock output (MCLK).

  ports:
    $ref: /schemas/graph.yaml#/properties/ports

    properties:
      port@0:
        $ref: /schemas/graph.yaml#/$defs/port-base
        unevaluatedProperties: false
        description: CSI-2 input on D-PHY A

        properties:
          endpoint:
            $ref: video-interfaces.yaml#
            unevaluatedProperties: false

            properties:
              data-lanes:
                minItems: 1
                items:
                  - const: 1
                  - const: 2

            required:
              - data-lanes

      port@1:
        $ref: /schemas/graph.yaml#/$defs/port-base
        unevaluatedProperties: false
        description: CSI-2 input on D-PHY C

        properties:
          endpoint:
            $ref: video-interfaces.yaml#
            unevaluatedProperties: false

            properties:
              data-lanes:
                items:
                  - const: 1

            required:
              - data-lanes

    required:
      - port@0
      - port@1

required:
  - compatible
  - reg
  - reg-names
  - interrupts
  - power-domains
  - '#clock-cells'
  - ports

additionalProperties: false

examples:
  - |
    #include <dt-bindings/interrupt-controller/arm-gic.h>

    camera@60800000 {
        compatible = "sprd,sc7730-dcam";
        reg = <0x60800000 0x1000>, <0x60c00000 0x1000>,
              <0x60d00000 0x100>, <0x60e00000 0x100>,
              <0x402e0000 0x100>;
        reg-names = "dcam", "csi", "mm-ahb", "mm-clk", "aon-apb";
        interrupts = <GIC_SPI 45 IRQ_TYPE_LEVEL_HIGH>;
        power-domains = <&pmu_domains 1>;
        #clock-cells = <0>;

        ports {
            #address-cells = <1>;
            #size-cells = <0>;

            port@0 {
                reg = <0>;

                endpoint {
                    remote-endpoint = <&rear_camera_out>;
                    data-lanes = <1 2>;
                };
            };

            port@1 {
                reg = <1>;

                endpoint {
                    remote-endpoint = <&front_camera_out>;
                    data-lanes = <1>;
                };
            };
        };
    };
...
```

## Documentation/devicetree/bindings/mfd/sprd,sc2723-adi-pmic.yaml
```yaml
# SPDX-License-Identifier: (GPL-2.0-only OR BSD-2-Clause)
%YAML 1.2
---
$id: http://devicetree.org/schemas/mfd/sprd,sc2723-adi-pmic.yaml#
$schema: http://devicetree.org/meta-schemas/core.yaml#

title: Spreadtrum SC2723 PMIC on the SC7730 ADI bus

maintainers:
  - Deniz Kokden <koekdendeniz@gmail.com>

description: |
  The SC2723 companion PMIC of the SC7730/SC8830 SoCs, reached through the
  SoC's analog-digital interface (ADI) at 0x40030000, whose software
  channel maps the PMIC registers to 0x40038000 and up. This node stands
  for the PMIC as seen through that fixed window; its children are the
  PMIC functions, with their register offset in the PMIC as unit address.

  The PMIC interrupt controller (ANA_INT, at offset 0x380) combines the
  interrupts of the PMIC functions into one SoC interrupt. Its sources -
    0 - auxiliary ADC
    1 - GPIO
    2 - RTC
    3 - watchdog
    4 - fuel gauge
    5 - EIC (power key, external reset input and other inputs)
    6 - headset button
    7 - audio protection
    8 - calibration
    9 - thermal protection (TPC)
    10 - DCDC over temperature

properties:
  compatible:
    const: sprd,sc2723-adi-pmic

  interrupts:
    maxItems: 1

  interrupt-controller: true

  '#interrupt-cells':
    const: 2

  '#address-cells':
    const: 1

  '#size-cells':
    const: 0

patternProperties:
  "^audio-codec@[0-9a-f]+$":
    type: object
    $ref: /schemas/sound/sprd,sc2723-codec.yaml#

  "^gpio@[0-9a-f]+$":
    type: object
    $ref: /schemas/gpio/sprd,gpio-eic.yaml#

  "^rtc@[0-9a-f]+$":
    type: object
    $ref: /schemas/rtc/sprd,sc2731-rtc.yaml#

required:
  - compatible
  - interrupts
  - interrupt-controller
  - '#interrupt-cells'
  - '#address-cells'
  - '#size-cells'

additionalProperties: false

examples:
  - |
    #include <dt-bindings/interrupt-controller/arm-gic.h>
    #include <dt-bindings/interrupt-controller/irq.h>

    pmic: pmic {
        compatible = "sprd,sc2723-adi-pmic";
        interrupts = <GIC_SPI 38 IRQ_TYPE_LEVEL_HIGH>;
        interrupt-controller;
        #interrupt-cells = <2>;
        #address-cells = <1>;
        #size-cells = <0>;

        rtc@80 {
            compatible = "sprd,sc2731-rtc";
            reg = <0x80>;
            interrupt-parent = <&pmic>;
            interrupts = <2 IRQ_TYPE_LEVEL_HIGH>;
        };

        gpio@100 {
            compatible = "sprd,sc2731-eic";
            reg = <0x100>;
            interrupt-parent = <&pmic>;
            interrupts = <5 IRQ_TYPE_LEVEL_HIGH>;
            gpio-controller;
            #gpio-cells = <2>;
            interrupt-controller;
            #interrupt-cells = <2>;
        };

        audio-codec@600 {
            compatible = "sprd,sc2723-codec";
            reg = <0x600>;
            #sound-dai-cells = <0>;
        };
    };
...
```
